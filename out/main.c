#include "LPC11XX.H"
#include "OLED_NEW.h"
#include "font.h"
#include "config.h"
#include "timer.h"
#include "pwm.h"
#include "adc.h"
#include "uart.h"
#include "stdio.h"
#define  SETMAX_TEMP 0x01       //宏定义设置上限温度值的地址

#define key1_dowm1() (LPC_GPIO3->DATA>>0&0x01)           //宏定义使用5个按键
#define key2_dowm2() (LPC_GPIO3->DATA>>1&0x01)
#define key3_dowm3() (LPC_GPIO3->DATA>>2&0x01)
#define key4_dowm4() (LPC_GPIO3->DATA>>3&0x01)
#define key5_dowm5() (LPC_GPIO3->DATA>>4&0x01)


 uint32_t timecounter=0;
 int hourTime=0;
 int minuteTime=0;

 
 uint8 Menu(void);
 int MyThermometer(void);
 
 
uint8  GUI_MenuDraw()      //画菜单
{
	    
	    GUI_HLine(0, 0, 128, 1);
		 	GUI_HLine(0, 12, 128, 1);
		  GUI_RLine(0, 0, 64, 1);
			GUI_RLine(127, 0, 64, 1);
			GUI_HLine(0, 63, 128, 1);

}
uint8 Juhao[]=                           //画句号（℃前面的点）
{
0x60,0x60,0x00,0x00,0x00,
};


 
uint8 Thermometer[]=                            //画第一个菜单中的温度计
{

0x00,0x00,0x00,0x00,0x00,0x00,0x00,0x00,
0x00,0x00,0x00,0x00,0x00,0x00,0x00,0x00,
0x00,0x00,0x00,0x00,0x00,0x00,0x00,0x00,
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0x00,0x00,0x00,0x00,0x00,0x00,0x00,0x00,

};




uint8 Shizhong[]=                           //画第二个菜单中的时钟
{
0x00,0x00,0x00,0x00,0x00,0x00,0x00,0x00,
0x00,0x00,0x00,0x00,0x00,0x00,0x00,0x00,
0x00,0x00,0x00,0x00,0x00,0x00,0x00,0x00,
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0x00,0x00,0x00,0x00,0x00,0x00,0x00,0x00,
0x00};

 
uint8 My_setting[]=                        //画第三个菜单中的设置图片
{

0x00,0x00,0x3E,0x00,0x00,0x00,0x00,0x7E,
0x00,0x00,0x00,0x3C,0x7E,0x3E,0x00,0x00,
0x7E,0x7E,0x3E,0x00,0x00,0xFE,0xFF,0x3F,
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0x7E,0x18,0x00,0x00,0x00,0x3E,0x00,0x00,
};







uint8 hours[12][2]={                       //画第二个菜单中时钟的时针旋转位置

{64,27},               //指向0
{71,29},               //指向1
{75,34},               //指向2
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{57,29},               //指向11


};

 
uint8 minute[60][2]={                      //画第二个菜单中时钟的分针旋转位置     

{64,23},               //指向0
{65,23},               //指向1
{66,23},               //指向2
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{63,23},               //指向59

};






/*******************
延时函数
********************/

//void Delay(int f)
//{
//	int i,j;
//	for(i=0;i<3000;i++)
//	for(j=0;j<f;j++);
//}
/*******************
32位定时计数器0中断服务函数
********************/

void TIMER32_0_IRQHandler(void)
{
	
	
   //if(++timecounter>=200)    //1s定时时间到
	 {
		  timecounter=0;            //秒计数器清零，开始下一秒计数
		 
		 
		  /************************************************/
		 
//		  GUI_LineWith(64,41,hours[hourTime][0],hours[hourTime][1],2,0);  
//			GUI_LineWith(64,41,minute[minuteTime][0],minute[minuteTime][1],1,0);
//		 
//		  if(minuteTime==59)hourTime++;
//			hourTime%=12;
			minuteTime++;
//			minuteTime%=60;
//		 
//		 	GUI_RectangleFill(0, 0, 128, 64, back_color);  //显示时钟中的内容
//	  	GUI_LoadPic(36,13,Shizhong,55,55);
//		  GUI_PutString(5,2,"2017.05.03 Wednesday");
//		 
//		 
//		  GUI_MenuDraw();
//		 
//		 
//		  GUI_LineWith(64,41,hours[hourTime][0],hours[hourTime][1],2,1);
//			GUI_LineWith(64,41,minute[minuteTime][0],minute[minuteTime][1],1,1);
			
     	
		  /*************************************************/  
	 }
	 
    LPC_TMR32B0->IR=0x01;    //向匹配通道0写1清除中断
 }
/***********************
 Descraption:32位定数计数器0初始化函数
 Note:允许中断，同时定时时间为1/500，即2ms
 ***********************/
 void  Timer0Init(void)
 {
  LPC_SYSCON->SYSAHBCLKCTRL|=(1<<9); //使能TIM32B0时钟
	LPC_TMR32B0->IR=0X01; //MR0中断复位，即清中断
	LPC_TMR32B0->PR=0; //每一个PCLK加1
	LPC_TMR32B0->MCR=0x03; //MR0匹配时复位TC，并产生中断
	LPC_TMR32B0->MR0=SystemCoreClock/200;//匹配时间，也就是定时时间，2ms
	LPC_TMR32B0->TCR=0X01;//启动定时器：TCR[0]=1;
	NVIC_EnableIRQ(TIMER_32_0_IRQn);   //使能中断

 
 }
 
 /***********************
作者：唐海月
 
功能：画窗口
 
版本：1.0
 ***********************/

WINDOWS Win;	
uint8 AS[7]="LPC1114";	


void WinInit(void)
{
		Win.x=0;
		Win.y=0;
		Win.hight=63;
		Win.with=127;
		Win.title=AS;
		Win.state=AS;
	
	
}

/************************
作者：唐海月

功能：我的温度，第一个菜单

版本：1.0
*************************/


 char Str[20];
 int MyThermometer(void)   
 {
  int Awhere=0;
	int flag=0;         //标志位
	 
  GUI_ClearSCR();
  int T=AT24C02_ReadOneByte(SETMAX_TEMP);     //从AT24C02中读取SETMAX_TEMP
	while(1)
		{
		      
			GUI_LoadPic(15,6, Thermometer,94,56);
			GUI_MenuDraw();
			GUI_PutString(12,2,"ranran and yueyue");
			GUI_LoadPic(110,50,Juhao,5,7);
			
			if(key1_dowm1()==0)          //当按键1按下的时候，进入ADC_Init的状态
				{
 				  T16B0_delay_ms(20);
					if(key1_dowm1()==0)
					{
					while((key1_dowm1()==0));
					Awhere++;
					Awhere%=2;
					}
					sprintf(GcRcvBuf,"Times= %d\r\n",Awhere);  //将数据发送到串口进行显示
			    UART_SendStr(GcRcvBuf); //将数据发送到串口显示
				}
				
			if( key5_dowm5()==0)        //当按键5按下的时候，返回到菜单界面
			 {
			  GUI_ClearSCR();
			  return 0;
		   }
			GetAdc();
			if(Awhere==1)
			{
				   sprintf(GcRcvBuf,"T= %d℃\r\n",Temp);  //将数据发送到串口进行显示
				   UART_SendStr(GcRcvBuf); //将数据发送到串口显示
			}
			sprintf(GcRcvBuf,"T=%3d C",Temp);  //将数据发送到串口进行显示
			GUI_PutString(80,50,GcRcvBuf);
			GUI_LoadPic(110,50,Juhao,5,7);
			GUI_RectangleFill(45,32,(Temp>77?77:Temp)-20+45,34,1);
		  
			
	
			
			// 判断上下限
	    if(Temp>=T&&flag==0)         //判断温度是否大于T，如果大于T，频率1000，警报
			{
				
				flag=1;
				Set_pwm(1000, 50);
			}
			else if (Temp>36&&flag==1)
			{
				;
			}						
			else if(Temp<T)
			{
				Set_pwm(1000,100);
			  flag=0;
			}
			
		  GUI_Exec();//更新一次屏幕缓冲	
	}	
 return 0; 
}
 


/********************
作者：唐海月

功能：我的时钟，第二个菜单

版本：1.0
*********************/



int MyClock(void)          //我的时钟，第二个菜单
 {
	   GUI_ClearSCR();
		 while(1)
		 {
			 
			   
					if( key5_dowm5()==0)
					{
						GUI_ClearSCR(); 
						return 0;
					}
					
					
					
					GUI_LineWith(64,41,hours[hourTime][0],hours[hourTime][1],2,0);  
					GUI_LineWith(64,41,minute[minuteTime][0],minute[minuteTime][1],1,0);
					
					
					if(minuteTime==59)
						hourTime++;
					hourTime%=12;
					minuteTime++;
					T16B0_delay_ms(100);
					minuteTime%=60;
					GUI_RectangleFill(0, 0, 128, 64, back_color);  //显示时钟中的内容
					GUI_LoadPic(36,13,Shizhong,55,55);
					GUI_PutString(5,2,"2017.05.03 Wednesday");
					GUI_MenuDraw();
					GUI_LineWith(64,41,hours[hourTime][0],hours[hourTime][1],2,1);
					GUI_LineWith(64,41,minute[minuteTime][0],minute[minuteTime][1],1,1);
			
      
		  GUI_Exec();//更新一次屏幕缓冲			
	    }  
 }
 
 
/********************
作者：唐海月
 
功能：我的设置，第三个个菜单
 
版本：1.0
*********************/
 
 int MySetting(void)    //我的设置，第三个菜单
 {
	   
	     int T=AT24C02_ReadOneByte(SETMAX_TEMP);  
	     char Tarray[20];
	     GUI_ClearSCR();
	     GUI_MenuDraw();
	     GUI_PutString(12,2,"ranran and yueyue");
       while(1)
			 {
			 	if( key5_dowm5()==0)        //当按键5按下的时候，返回到菜单界面
			 {
			  GUI_ClearSCR();
				 
				AT24C02_WriteOneByte(SETMAX_TEMP, T);       
				 
			  return 0;
		   } 
			 

			 
			 
			 if( key1_dowm1()==0)
			 {
	          T16B0_delay_ms(20);
	          if( key1_dowm1()==0)        //当按键5按下的时候，返回到菜单界面
	          {
							while( (key1_dowm1()==0));
							T++;	
	          } 
			}
			 
			 
			 if( key2_dowm2()==0)        //当按键5按下的时候，返回到菜单界面
			 { T16B0_delay_ms(20);
	          if( key2_dowm2()==0)        //当按键5按下的时候，返回到菜单界面
	          {
							while( (key2_dowm2()==0));
							T--;	
	          } 
		   } 
			 
			 
			 
			 if(T<1)T=1;         //设置 设置温度的上下限（1~100）
			 else if(T>100)T=100;
	     sprintf(Tarray,"Max:%3d",T);
			 GUI_PutString(75,35,Tarray);
			 
			 
			 
			  GUI_LoadPic(25,17,My_setting,40,40);
			  GUI_Exec();//更新一次屏幕缓冲	 
			 }
         
       
 }
 
 
 
 
/****************************
作者：唐海月
 
功能：屏幕显示的主菜单
 
版本：1.0
*****************************/
uint8 Menu(void)
{
  int where=0;
	GUI_PutString(32,17,"My Thermometer");
	GUI_PutString(32,28,"My Clock");
  GUI_PutString(32,39,"My Setting");
	
  while(1)
 {
	  GUI_WindowsDraw(&Win);
	 
	 	GUI_PutString(32,17,"My Thermometer");
		GUI_PutString(32,28,"My Clock");
		GUI_PutString(32,39,"My Setting");
		
		if(key3_dowm3()==0)
		{
		where=2;
		}
		
		if(key1_dowm1()==0)
		{
	  where=0;
		}
	  ;
		if(key2_dowm2()==0)
		{
		where=1;
		}

switch(where)
{
	case 0:
	{
		GUI_PutString(20,28," ");
		GUI_PutString(20,39," ");
		GUI_PutString(20,17,"*");
		};break;
	case 1:
	{
		GUI_PutString(20,17," ");
		GUI_PutString(20,39," ");
		GUI_PutString(20,28,"*");
		}break;
	case 2:
	{
		GUI_PutString(20,17," ");
		GUI_PutString(20,28," ");
		GUI_PutString(20,39,"*");
	}
}
			
		if(key4_dowm4()==0)
		{
		   switch(where)
			 {
				 case 0:for(int i=20;i<120;i+=5)GUI_PutString(i,17,"-"); return 1;break;
			   case 1:for(int i=20;i<120;i+=5)GUI_PutString(i,28,"-"); return 2;break;
			   case 2:for(int i=20;i<120;i+=5)GUI_PutString(i,39,"-"); return 3;break;
			 }
		 }
   
 GUI_Exec();//更新一次屏幕缓冲	
}
}
 

/****************************

功能：主函数，所有功能的初始化


****************************/



int main(void)
{
		OLED_Init();
		GUI_SetColor(1,0);//此时是正常显示，若(0,1)则反色显示	
    Key_init();
		ADC_Init();
	
    UART_Init();//串口初始化
	  T16B0_init();
	  TIM32B0_PWM(1000,100);
		int CASE=0;
    
	  I2C_Init();
		while(AT24C02_Check()) ; 
	
	
		WinInit();	
		GUI_WindowsDraw(&Win);
		while(1)
		{
			
			switch(CASE)
			{
				case 0:CASE=Menu(); break;
		    case 1:CASE=MyThermometer();break;
			  case 2:CASE=MyClock();break;
				case 3:CASE=MySetting();break;
				default :CASE=0;

			}
			
		}
			
			
}
	

		
	







