#include "LPC11XX.H"
#include "OLED_NEW.h"
#include "font.h"
#include "config.h"
#include "music.h"
#include "timer.h"
#include "pwm.h"
#include "adc.h"
#include "uart.h"
#include "stdio.h"


#define key1_dowm1() (LPC_GPIO3->DATA>>0&0x01)
#define key2_dowm2() (LPC_GPIO3->DATA>>1&0x01)
#define key3_dowm3() (LPC_GPIO3->DATA>>2&0x01)
#define key4_dowm4() (LPC_GPIO3->DATA>>3&0x01)
#define key5_dowm5() (LPC_GPIO3->DATA>>4&0x01)


 uint32_t timecounter=0;
 int hourTime=0;
 int minuteTime=0;

 
 uint8 Menu(void);
 int MyThermometer(void);
 
 
uint8  GUI_MenuDraw()      //菜单
{
	    
	    GUI_HLine(0, 0, 128, 1);
		 	GUI_HLine(0, 12, 128, 1);
		  GUI_RLine(0, 0, 64, 1);
			GUI_RLine(127, 0, 64, 1);
			GUI_HLine(0, 63, 128, 1);

}
uint8 Juhao[]=
{
0x60,0x60,0x00,0x00,0x00,
};





 
uint8 Thermometer[]=
{

0x00,0x00,0x00,0x00,0x00,0x00,0x00,0x00,
0x00,0x00,0x00,0x00,0x00,0x00,0x00,0x00,
0x00,0x00,0x00,0x00,0x00,0x00,0x00,0x00,
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0x00,0x00,0x00,0x00,0x00,0x00,0x00,0x00,

};




uint8 Shizhong[]=
{
0x00,0x00,0x00,0x00,0x00,0x00,0x00,0x00,
0x00,0x00,0x00,0x00,0x00,0x00,0x00,0x00,
0x00,0x00,0x00,0x00,0x00,0x00,0x00,0x00,
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0x00,0x00,0x00,0x00,0x00,0x00,0x00,0x00,
0x00};



uint8 hours[12][2]={

{64,27},               //指向0
{71,29},               //指向1
{75,34},               //指向2
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{57,29},               //指向11


};


uint8 minute[60][2]={

{64,23},               //指向0
{65,23},               //指向1
{66,23},               //指向2
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{63,23},               //指向59

};






/*******************
延时函数
********************/

void Delay(int f)
{
	int i,j;
	for(i=0;i<3000;i++)
	for(j=0;j<f;j++);
}
/*******************
32位定时计数器0中断服务函数
********************/

void TIMER32_0_IRQHandler(void)
{
	
	
   if(++timecounter>=200)    //1s定时时间到
	 {
		  timecounter=0;            //秒计数器清零，开始下一秒计数
		 
		 
		  /************************************************/
		 
//		  GUI_LineWith(64,41,hours[hourTime][0],hours[hourTime][1],2,0);  
//			GUI_LineWith(64,41,minute[minuteTime][0],minute[minuteTime][1],1,0);
//		 
//		  if(minuteTime==59)hourTime++;
//			hourTime%=12;
//			minuteTime++;
//			minuteTime%=60;
//		 
//		 	GUI_RectangleFill(0, 0, 128, 64, back_color);  //显示时钟中的内容
//	  	GUI_LoadPic(36,13,Shizhong,55,55);
//		  GUI_PutString(5,2,"2017.05.03 Wednesday");
//		 
//		 
//		  GUI_MenuDraw();
//		 
//		 
//		  GUI_LineWith(64,41,hours[hourTime][0],hours[hourTime][1],2,1);
//			GUI_LineWith(64,41,minute[minuteTime][0],minute[minuteTime][1],1,1);
			
     	
		  /*************************************************/  
	 }
	 
	  
    LPC_TMR32B0->IR=0x01;    //向匹配通道0写1清除中断
 }
/***********************
 Descraption:32位定数计数器0初始化函数
 Note:允许中断，同时定时时间为1/500，即2ms
 ***********************/
 void  Timer0Init(void)
 {
  LPC_SYSCON->SYSAHBCLKCTRL|=(1<<9); //使能TIM32B0时钟
	LPC_TMR32B0->IR=0X01; //MR0中断复位，即清中断
	LPC_TMR32B0->PR=0; //每一个PCLK加1
	LPC_TMR32B0->MCR=0x03; //MR0匹配时复位TC，并产生中断
	LPC_TMR32B0->MR0=SystemCoreClock/200;//匹配时间，也就是定时时间，2ms
	LPC_TMR32B0->TCR=0X01;//启动定时器：TCR[0]=1;
	NVIC_EnableIRQ(TIMER_32_0_IRQn);   //使能中断

 
 }
 
 /***********************
 菜单部分
 ***********************/

WINDOWS Win;	
uint8 AS[7]="LPC1114";	


void WinInit(void)
{
		Win.x=0;
		Win.y=0;
		Win.hight=63;
		Win.with=127;
		Win.title=AS;
		Win.state=AS;
	
	
	
}
int MyClock(void)
 {
		 while(1)
		 {
					if( key5_dowm5()==0)
					{
						GUI_ClearSCR(); 
						return 0;
					}
					GUI_LineWith(64,41,hours[hourTime][0],hours[hourTime][1],2,0);  
					GUI_LineWith(64,41,minute[minuteTime][0],minute[minuteTime][1],1,0);
					if(minuteTime==59)hourTime++;
					hourTime%=12;
					minuteTime++;
					minuteTime%=60;
					GUI_RectangleFill(0, 0, 128, 64, back_color);  //显示时钟中的内容
					GUI_LoadPic(36,13,Shizhong,55,55);
					GUI_PutString(5,2,"2017.05.03 Wednesday");
					GUI_MenuDraw();
					GUI_LineWith(64,41,hours[hourTime][0],hours[hourTime][1],2,1);
					GUI_LineWith(64,41,minute[minuteTime][0],minute[minuteTime][1],1,1);
			
      
		  GUI_Exec();//更新一次屏幕缓冲			
	    }  
 }
 
 
 
 
char Str[20];
 int MyThermometer(void)
 {
  int Awhere=0;
	int flag=0;
	 
  GUI_ClearSCR();
	
	while(1)
		{
		
			GUI_LoadPic(15,6, Thermometer,94,56);
			GUI_MenuDraw();
			GUI_PutString(12,2,"ranran and yueyue");
			GUI_LoadPic(110,50,Juhao,5,7);
			
			if(key1_dowm1()==0)          //当按键1按下的时候，进入ADC_Init的状态
				{
//				delay_ms(20);
					if(key1_dowm1()==0)
					{
					while((key1_dowm1()==0));
					Awhere++;
					Awhere%=2;
					}
					sprintf(GcRcvBuf,"Times= %d\r\n",Awhere);  //将数据发送到串口进行显示
			    UART_SendStr(GcRcvBuf); //将数据发送到串口显示
				}
				
			if( key5_dowm5()==0)        //当按键5按下的时候，返回到菜单界面
			 {
			  GUI_ClearSCR();
			  return 0;
		   }
			GetAdc();
			if(Awhere==1)
			{
				   sprintf(GcRcvBuf,"T= %d℃\r\n",Temp);  //将数据发送到串口进行显示
				   UART_SendStr(GcRcvBuf); //将数据发送到串口显示
			}
			sprintf(GcRcvBuf,"T=%3d C",Temp);  //将数据发送到串口进行显示
			GUI_PutString(80,50,GcRcvBuf);
			GUI_LoadPic(110,50,Juhao,5,7);
			GUI_RectangleFill(45,32,(Temp>77?77:Temp)-20+45,34,1);
		  
			
	    if(Temp>=77&&flag==0)         //判断温度是否大于77，如果大于77，频率5000，警报
			{
				Set_pwm(5000, 400);
			}
			else if (Temp<77&&flag==1)
			{
				;
			}						
			else Set_pwm(0, 400);

			
		  GUI_Exec();//更新一次屏幕缓冲	
	}	
 return 0; 
}
 
	
uint8 Menu(void)
{
  int where=0;
	GUI_PutString(32,17,"My Thermometer");
	GUI_PutString(32,28,"My Clock");
  GUI_PutString(32,39,"My Music");
	
  while(1)
 {
	  GUI_WindowsDraw(&Win);
	 
	 	GUI_PutString(32,17,"My Thermometer");
		GUI_PutString(32,28,"My Clock");
		GUI_PutString(32,39,"My Music");
		
		if(key3_dowm3()==0)
		{
		where=2;
		}
		
		if(key1_dowm1()==0)
		{
	  where=0;
		}
	  ;
		if(key2_dowm2()==0)
		{
		where=1;
		}

switch(where)
{
	case 0:
	{
		GUI_PutString(20,28," ");
		GUI_PutString(20,39," ");
		GUI_PutString(20,17,"*");
		};break;
	case 1:
	{
		GUI_PutString(20,17," ");
		GUI_PutString(20,39," ");
		GUI_PutString(20,28,"*");
		}break;
	case 2:
	{
		GUI_PutString(20,17," ");
		GUI_PutString(20,28," ");
		GUI_PutString(20,39,"*");
	}
}
			
		if(key4_dowm4()==0)
		{
		   switch(where)
			 {
				 case 0:for(int i=20;i<120;i+=5)GUI_PutString(i,17,"-"); return 1;break;
			   case 1:for(int i=20;i<120;i+=5)GUI_PutString(i,28,"-"); return 2;break;
			   case 2:for(int i=20;i<120;i+=5)GUI_PutString(i,39,"-");break;
			 }
		 }
   
 GUI_Exec();//更新一次屏幕缓冲	
}
}
 
 

;

int main(void)
{
		OLED_Init();
		GUI_SetColor(1,0);//此时是正常显示，若(0,1)则反色显示	
    Key_init();
		ADC_Init();
    UART_Init();//串口初始化
	  TIM32B0_PWM(0,0);
		int CASE=0;

		 
		WinInit();	
		GUI_WindowsDraw(&Win);
		while(1)
		{
			
			switch(CASE)
			{
				case 0:CASE=Menu(); 	break;
		    case 1:CASE=MyThermometer();break;
			  case 2:CASE=MyClock();break;
				default :CASE=0;
				 
				
			}
		}
			
			
}
	

		
	







